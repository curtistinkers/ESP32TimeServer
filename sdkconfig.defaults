## sdkconfig.defaults
```kconfig
# Required to build on ESP-IDF v5.5.3+
CONFIG_FREERTOS_HZ=1000

CONFIG_ESPTOOLPY_FLASHSIZE_32MB=y
CONFIG_ESPTOOLPY_FLASHSIZE="32MB"

CONFIG_PARTITION_TABLE_CUSTOM=y
CONFIG_PARTITION_TABLE_CUSTOM_FILENAME="partitions.csv"
CONFIG_PARTITION_TABLE_FILENAME="partitions.csv"

CONFIG_IDF_TARGET="esp32p4"
CONFIG_IDF_TARGET_ESP32P4=y

CONFIG_ARDUINO_VARIANT="esp32p4"

# Required to build on ESP-IDF v6.0.2+
CONFIG_LIBC_NEWLIB=y
CONFIG_COMPILER_DISABLE_DEFAULT_ERRORS=y
```
